## drivers/input/sec_input/Kconfig
```kconfig
#
# SEC Input device configuration
#

config INPUT_SEC_INPUT
	tristate "Support for SEC input layer"
	default y


source "drivers/input/sec_input/slsi/Kconfig"
```
